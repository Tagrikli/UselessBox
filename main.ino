#include "Servo.h"

Servo servo; // create servo object to control a servo
uint8_t val, pos, size = 11, prevInd = random(size);

int moveBuffer[][35] = {{3, 3, 3, 3, 3, 3, 599, 599, 599, 599, 599, 599, 599,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 599, 599},
                        {3, 3, 3, 3, 121, 417, 438, 438, 438, 438, 303, 160, 155,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 599, 599},
                        {5, 5, 5, 117, 422, 566, 597, 597, 597, 597, 597, 597, 597,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 597, 597},
                        {4, 413, 480, 405, 37, 37, 367, 427, 432, 83, 77, 404, 417,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 599, 599},
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                        {5, 5, 5, 117, 422, 566, 597, 597, 597, 597, 597, 597, 597,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 597, 597}}; 

struct Arm
{
    uint8_t defPos = 170;
    uint8_t initPos = defPos;

    void go(uint8_t val)
    {
        servo.write(val);
        initPos = val;
    }

} arm;

void setup()
{
    servo.attach(10);
    pinMode(11, INPUT);
    Serial.begin(9600);
    arm.go(arm.defPos);
}

void loop()
{
    val = digitalRead(11);

    if (val == HIGH)
    {
        //delay(50);
        uint8_t ind = random(size);
        while (ind == prevInd)
        {
            ind = random(size);
        }
        prevInd = ind;
        ;

        for (int pos : moveBuffer[ind])//ind
        {
            pos = map(pos, 0, 600, 170, 85);
            arm.go(pos);
            delay(150);

            if (digitalRead(11) == LOW)
            {
                arm.go(arm.defPos);
                break;
            }
        }
    }
}